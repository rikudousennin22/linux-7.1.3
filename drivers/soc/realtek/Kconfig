## drivers/soc/realtek/Kconfig
```kconfig
config ARCH_RTD16xx
	bool "Realtek RTD16xx SoC family"
	default y

config RTD119X
	bool "Realtek RTD119X SoC family specific drivers"
	depends on ARCH_RTD119X
	default n
	help
	  Realtek RTD119X SoC family specific support.

	  If unsure, say N.

if RTD119X
# source "drivers/soc/realtek/rtd119x/Kconfig"
endif

config RTD129x
	bool "Realtek RTD129x SoC family specific drivers"
	depends on ARCH_RTD129x
	default n
	help
	  Realtek RTD129x SoC family specific support.

	  If unsure, say N.

if RTD129x
# source "drivers/soc/realtek/rtd129x/Kconfig"
endif # RTD129x

config RTD129x_FPGA
	bool "Realtek RTD129x FPGA"
	depends on ARCH_RTD129x
	select RTK_PLATFORM_FPGA
	default n
	help
	   FPGA without boot code.

config RTD139x
	bool "Realtek RTD139x SoC family specific drivers"
	depends on ARCH_RTD139x
	default n
	help
	  Realtek RTD139x SoC family specific support.

	  If unsure, say N.

if RTD139x
# source "drivers/soc/realtek/rtd139x/Kconfig"
endif # RTD139x

config RTD139x_FPGA
	bool "Realtek RTD139x FPGA"
	depends on ARCH_RTD139x
	select RTK_PLATFORM_FPGA
	default n
	help
	   FPGA without boot code.

config RTD16xx
	bool "Realtek RTD16xx SoC family specific drivers"
	depends on ARCH_RTD16xx
	default y
	help
	  Realtek RTD16xx SoC family specific support.

	  If unsure, say N.

if RTD16xx
source "drivers/soc/realtek/rtd16xx/Kconfig"
endif # RTD16xx

config RTD16xx_FPGA
	bool "Realtek RTD16xx FPGA"
	depends on ARCH_RTD16xx
	select RTK_PLATFORM_FPGA
	default n
	help
	  FPGA without boot code.

config RTD13xx
	bool "Realtek RTD13xx SoC family specific drivers"
	depends on ARCH_RTD13xx
	default n
	help
	  Realtek RTD13xx SoC family specific support.

	  If unsure, say N.

if RTD13xx
# source "drivers/soc/realtek/rtd13xx/Kconfig"
endif # RTD13xx

config RTD13xx_FPGA
	bool "Realtek RTD13xx FPGA"
	depends on ARCH_RTD13xx
	select RTK_PLATFORM_FPGA
	default n
	help
	  FPGA without boot code.

config RTK_PLATFORM_FPGA
	def_bool n

config RTK_XEN_SUPPORT
	bool "Realtek XEN support"
	depends on XEN
	default n
	help
	  Realtek XEN utility support.

if RTK_XEN_SUPPORT
source "drivers/soc/realtek/xen/Kconfig"

endif

source "drivers/soc/realtek/common/Kconfig"
```

## drivers/thermal/realtek/Kconfig
```kconfig
config RTK_THERMAL
	tristate "Realtek Thermal Sensor"
	depends on THERMAL && OF
	help
	  This is the driver for the Realtek thermal sensor.

config RTK_THERMAL_RTD16XX
	bool "Realtek RTD16XX Thermal Sensor"
	depends on RTK_THERMAL
	default y
	help
	  This enables the Realtek RTD16XX thermal sensor driver.
```
